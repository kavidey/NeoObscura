/*********************************************************************
*                    SEGGER Microcontroller GmbH                     *
*                        The Embedded Experts                        *
**********************************************************************

-------------------------- END-OF-HEADER -----------------------------

File    : main.c
Purpose : Generic application start

*/



#include <stdio.h>
#include <stm32l432xx.h>
#include "/Users/neilchulani/Documents/Polarbear/College/Classes/Engineering/MicroPs/HMC-E155/lab/lab07/lab07_mcu/lib/STM32L432KC.h"
#include <time.h>

#define MSPI                PA6
#define reset               PA5
#define encodedByteReady    PA4
#define readyForPixel       PA3
#define finalPixel          PA1
#define doneEncoding        PA2

struct pixel {
    uint8_t r;
    uint8_t g;
    uint8_t b;
    uint8_t a;
};

int main(void) {

  RCC->AHB2ENR |= (RCC_AHB2ENR_GPIOAEN | RCC_AHB2ENR_GPIOBEN | RCC_AHB2ENR_GPIOCEN);

  // Load and done pins
  pinMode(reset, GPIO_OUTPUT);  // reset
  pinMode(MSPI, GPIO_OUTPUT);  // mcu performing spi
  pinMode(finalPixel, GPIO_OUTPUT);
  pinMode(encodedByteReady, GPIO_INPUT);   // chunkReady
  pinMode(readyForPixel, GPIO_INPUT);   // ready for data
  pinMode(doneEncoding, GPIO_INPUT);

  int numPixels = 1200;

  // initialize random pixels
  struct pixel pixels[1200] = {
    { 190, 70, 224, 213 },
    { 121, 200, 89, 58 },
    { 58, 62, 234, 181 },
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    { 170, 75, 126, 90 },
};

  volatile int c = 0;
  digitalWrite(reset, 1); // set reset high
  while (c < 10000) {c++;}
  c = 0;
  digitalWrite(reset, 0); // set reset low

  digitalWrite(MSPI, 0); // Initialize MSPI low
  digitalWrite(finalPixel, 0); // Initialize finalPixel low

  char bytes[6500]; 

  for (int count = 0; count < 6500; count++) {
    bytes[count] = 0xCC;
  }

  // start 14 byte header
  bytes[0] = 0x71; // q
  bytes[1] = 0x6F; // o
  bytes[2] = 0x69; // i
  bytes[3] = 0x66; // f

  uint32_t width = 40;
  uint32_t height = 30;

  // Smiley face attempt
  for (int b = 0; b < 1200; b++) {
    pixels[b].r = 0x00;
    pixels[b].g = 0x00;
    pixels[b].b = 0x00;
    pixels[b].a = 0xff;
  }

  pixels[293-1].r = 0x00;
  pixels[293-1].g = 0xFF;
  pixels[293-1].b = 0x00;
  pixels[293-1].a = 0xFF;
  pixels[293+15].r = 0x00;
  pixels[293+15].g = 0xFF;
  pixels[293+15].b = 0x00;
  pixels[293+15].a = 0xFF;
  for (int b = 0; b < 15; b++) {
    pixels[733 + b].r = 0x00;
    pixels[733 + b].g = 0xFF;
    pixels[733 + b].b = 0x00;
    pixels[733 + b].a = 0xFF;
  }
  for (int b = 0; b < 4; b++) {
    pixels[573 + (40*b)].r = 0x00;
    pixels[573 + (40*b)].g = 0xFF;
    pixels[573 + (40*b)].b = 0x00;
    pixels[573 + (40*b)].a = 0xFF;
  }
  for (int b = 0; b < 4; b++) {
    pixels[587 + (40*b)].r = 0x00;
    pixels[587 + (40*b)].g = 0xFF;
    pixels[587 + (40*b)].b = 0x00;
    pixels[587 + (40*b)].a = 0xFF;
  }
  // end smiley face attempt


  // 14 byte header
  bytes[4] = ((width >> 24) & 0xFF);
  bytes[5] = ((width >> 16) & 0xFF);
  bytes[6] = ((width >> 8) & 0xFF);
  bytes[7] = (width & 0xFF);
  bytes[8] = ((height >> 24) & 0xFF);
  bytes[9] = ((height >> 16) & 0xFF);
  bytes[10] = ((height >> 8) & 0xFF);
  bytes[11] = (height & 0xFF);
  bytes[12] = 4;
  bytes[13] = 1;
  // end 14 byte header

  // polarity = 0, phase = 1
  initSPI(5, 0, 1);
  
  int i = 0;
  volatile int j = 14;
  while (i < numPixels) {
    if (digitalRead(readyForPixel)) {
      if (i == (numPixels - 1)) {
        digitalWrite(finalPixel, 1);
      }
      spiSendReceive(pixels[i].r);
      while(SPI1->SR & SPI_SR_BSY);
      spiSendReceive(pixels[i].g);
      while(SPI1->SR & SPI_SR_BSY);
      spiSendReceive(pixels[i].b);
      while(SPI1->SR & SPI_SR_BSY);
      spiSendReceive(pixels[i].a);
      while(SPI1->SR & SPI_SR_BSY);
      digitalWrite(MSPI, 1);
      while (c < 100) {c++;}
      c = 0;
      digitalWrite(MSPI, 0);
      i++;
    }
    if (digitalRead(encodedByteReady)) {
      bytes[j] = spiSendReceive(0xF);
      while(SPI1->SR & SPI_SR_BSY);
      digitalWrite(MSPI, 1);
      while (c < 100) {c++;}
      c = 0;
      digitalWrite(MSPI, 0);
      j++;
    }
  }

  while(!digitalRead(doneEncoding)) {
    if (digitalRead(encodedByteReady)) {
      bytes[j] = spiSendReceive(0xF);
      while(SPI1->SR & SPI_SR_BSY);
      digitalWrite(MSPI, 1);
      while (c < 100) {c++;}
      c = 0;
      digitalWrite(MSPI, 0);
      j++;
    }
  }


  // 8 byte end marker
  bytes[j] = 0x00;
  bytes[j+1] = 0x00;
  bytes[j+2] = 0x00;
  bytes[j+3] = 0x00;
  bytes[j+4] = 0x00;
  bytes[j+5] = 0x00;
  bytes[j+6] = 0x00;
  bytes[j+7] = 0x01;

   while(1);



}
